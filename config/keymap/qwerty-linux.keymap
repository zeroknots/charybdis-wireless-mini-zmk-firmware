/* Linux GUI shortcuts with terminal paste on held V and layer clipboard actions.
 * Shared DTSI helpers are staged by the existing Bluetooth/USB build workflow.
 */
#define CHARYBDIS_LINUX
#include "qwerty.dtsi"
